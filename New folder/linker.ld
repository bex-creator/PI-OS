ENTRY(_start)

SECTIONS
{
    /* Raspberry Pi 64-bit kernel load address */
    . = 0x80000;

    .text.boot : { *(.text.boot) }
    .text : { *(.text) }
    .rodata : { *(.rodata) }
    .data : { *(.data) }
    
    .bss : {
        . = ALIGN(16);
        __bss_start = .;
        *(.bss*)
        *(COMMON)
        __bss_end = .;
    }
}